;PORT/PIN settings for S1D15705

S1D15705_RD     equ PA0
S1D15705_WR     equ PA1
S1D15705_A0     equ PA2
S1D15705_RES    equ PA3
S1D15705_CS     equ PA4

S1D15705_D0     equ PB0
S1D15705_D1     equ PB1
S1D15705_D2     equ PB2
S1D15705_D3     equ PB3
S1D15705_D4     equ PB4
S1D15705_D5     equ PB5
S1D15705_D6     equ PB6
S1D15705_D7     equ PB7

S1D15705_RD_N     equ ($ff - S1D15705_RD)
S1D15705_WR_N     equ ($ff - S1D15705_WR)
S1D15705_A0_N     equ ($ff - S1D15705_A0)
S1D15705_RES_N    equ ($ff - S1D15705_RES)
S1D15705_CS_N     equ ($ff - S1D15705_CS)


S1D15705_DATAPORT       equ VIA_ORB
S1D15705_DATAPORT_DIR   equ VIA_DDRB

S1D15705_CTRLPORT       equ VIA_ORA
S1D15705_CTRLPORT_DIR   equ VIA_DDRA



;Control/status register 
;Status     |  BUSY | ADC | ON/OF | RESET | 0 | 0 | 0 | 0 |


;S1D15705 Read status:
CR_BUSY  equ   %10000000   ;  Operation stil in progress  0 - busy, 1- ready to next instruction
CR_ADC   equ   %01000000   ;  Screen invesion. 0 - inversion enabled, 1 - inversion disabled
CR_ONOF  equ   %00100000   ;  Display on/of. 0 - display is on
CR_RESET equ   %00010000   ;  1 - display during reset procedure, all commands except Read Status are ignored
CR_NA3   equ   %00001000   ;  n/a
CR_NA2   equ   %00000100   ;  n/a
CR_NA1   equ   %00000010   ;  n/a
CR_NA0   equ   %00000001   ;  n/a

;commands
S1D_DISPLAYON       equ %10101111   
S1D_DISPLAYOFF      equ %10101110
S1D_STARTLINE       equ %01000000   ;value from 01000000 to 01111111
S1D_SETPAGE         equ %10110000   ;value from 10110000 to 10111000 
S1D_SETPAGE0        equ %10110000   
S1D_SETPAGE1        equ %10110001   
S1D_SETPAGE2        equ %10110010   
S1D_SETPAGE3        equ %10110011   
S1D_SETPAGE4        equ %10110100   
S1D_SETPAGE5        equ %10110101   
S1D_SETPAGE6        equ %10110110   
S1D_SETPAGE7        equ %10110111   
S1D_SETCOLL_H       equ %00010000   ;value from 00010000 to 00011111 for A7, A6, A5, A4   
S1D_SETCOLL_L       equ %00000000   ;value from 00000000 to 00001111 for A3, A2, A1, A0


LCD_MAX_COLLS   equ 162  ; max LCD collumns 


;definitions
.define poke mva #%%2 %%1

    ORG   *


.array font5x8 .byte
$00, $00, $00, $00, $00 ; space 
$00, $00, $5F, $00, $00 ; !
$00, $07, $00, $07, $00 ; "
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$20, $10, $08, $04, $02 ; /
$3E, $51, $49, $45, $3E ; 0
$00, $42, $7F, $40, $00 ; 1
$42, $61, $51, $49, $46 ; 2
$21, $41, $45, $4B, $31 ; 3
$18, $14, $12, $7F, $10 ; 4
$27, $45, $45, $45, $39 ; 5
$3C, $4A, $49, $49, $30 ; 6
$01, $71, $09, $05, $03 ; 7
$36, $49, $49, $49, $36 ; 8
$06, $49, $49, $29, $1E ; 9
$00, $36, $36, $00, $00 ; :
$00, $56, $36, $00, $00 ; ;
$00, $08, $14, $22, $41 ; <
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$08, $1C, $2A, $08, $08 ; <-
.enda

.array font8x8 .byte
$ff, $81, $81, $81, $81, $81, $81, $ff ; empty square 
$ff, $81, $81, $81, $81, $81, $81, $ff ; empty square 
$ff, $81, $81, $81, $81, $81, $81, $ff ; empty square 
$ff, $81, $81, $81, $81, $81, $81, $ff ; empty square 
$ff, $81, $81, $81, $81, $81, $81, $ff ; empty square 
$ff, $81, $81, $81, $81, $81, $81, $ff ; empty square 
$ff, $81, $81, $81, $81, $81, $81, $ff ; empty square 
$ff, $81, $81, $81, $81, $81, $81, $ff ; empty square 
$ff, $81, $81, $81, $81, $81, $81, $ff ; empty square 
$ff, $81, $81, $81, $81, $81, $81, $ff ; empty square 
$ff, $81, $81, $81, $81, $81, $81, $ff ; empty square 
$ff, $81, $81, $81, $81, $81, $81, $ff ; empty square 
$ff, $81, $81, $81, $81, $81, $81, $ff ; empty square 
$ff, $81, $81, $81, $81, $81, $81, $ff ; empty square 
$ff, $81, $81, $81, $81, $81, $81, $ff ; empty square 
$ff, $81, $81, $81, $81, $81, $81, $ff ; empty square 
$ff, $81, $81, $81, $81, $81, $81, $ff ; empty square 
$ff, $81, $81, $81, $81, $81, $81, $ff ; empty square 
$ff, $81, $81, $81, $81, $81, $81, $ff ; empty square 
$ff, $81, $81, $81, $81, $81, $81, $ff ; empty square 
$ff, $81, $81, $81, $81, $81, $81, $ff ; empty square 
$00, $00, $00, $00, $00 ,$00, $00, $00 ; space
.enda

.array A800 [1666] .byte
$00, $00, $00, $00, $00, $00, $00, $00, $00, $00, $00, $00, $00, $00, $00, $00
$00, $00, $00, $00, $00, $00, $00, $00, $00, $00, $00, $00, $00, $00, $00, $00
$00, $00, $00, $00, $00, $00, $00, $00, $00, $00, $00, $00, $00, $00, $00, $00
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$00, $00, $00, $00, $00, $00, $00, $00, $00, $00, $00, $00, $00, $00, $00, $00
.enda

.array screen [$0510] .byte
//$0000-$00ff
$00, $00, $00, $00, $00, $00, $00, $00, $00, $00, $00, $00, $00, $00, $00, $00
$00, $00, $00, $00, $00, $00, $00, $00, $00, $00, $00, $00, $00, $00, $00, $00
$00, $00, $00, $00, $00, $00, $00, $00, $00, $00, $00, $00, $00, $00, $00, $00
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$00, $00, $00, $00, $00, $00, $00, $00, $00, $00, $00, $00, $00, $00, $00, $00 
//$0100-$01ff
$00, $00, $00, $00, $00, $00, $00, $00, $00, $00, $00, $00, $00, $00, $00, $00
$00, $00, $00, $00, $00, $00, $00, $00, $00, $00, $00, $00, $00, $00, $00, $00
$00, $00, $00, $00, $00, $00, $00, $00, $00, $00, $00, $00, $00, $00, $00, $00
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$00, $00, $00, $00, $00, $00, $00, $00, $00, $00, $00, $00, $00, $00, $00, $00
//$0200-$02ff
$00, $00, $00, $00, $00, $00, $00, $00, $00, $00, $00, $00, $00, $00, $00, $00
$00, $00, $00, $00, $00, $00, $00, $00, $00, $00, $00, $00, $00, $00, $00, $00
$00, $00, $00, $00, $00, $00, $00, $00, $00, $00, $00, $00, $00, $00, $00, $00
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$00, $00, $00, $00, $00, $00, $00, $00, $00, $00, $00, $00, $00, $00, $00, $00
//$0300-$03ff
$00, $00, $00, $00, $00, $00, $00, $00, $00, $00, $00, $00, $00, $00, $00, $00
$00, $00, $00, $00, $00, $00, $00, $00, $00, $00, $00, $00, $00, $00, $00, $00
$00, $00, $00, $00, $00, $00, $00, $00, $00, $00, $00, $00, $00, $00, $00, $00
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$00, $00, $00, $00, $00, $00, $00, $00, $00, $00, $00, $00, $00, $00, $00, $00
//$0400-$04ff
$00, $00, $00, $00, $00, $00, $00, $00, $00, $00, $00, $00, $00, $00, $00, $00
$00, $00, $00, $00, $00, $00, $00, $00, $00, $00, $00, $00, $00, $00, $00, $00
$00, $00, $00, $00, $00, $00, $00, $00, $00, $00, $00, $00, $00, $00, $00, $00
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$00, $00, $00, $00, $00, $00, $00, $00, $00, $00, $00, $00, $00, $00, $00, $00

//$0500-$0509
$00, $00, $00, $00, $00, $00, $00, $00, $00, $00
.enda

lcd_page0   equ (screen)
lcd_page1   equ (screen + 162*1)
lcd_page2   equ (screen + 162*2)
lcd_page3   equ (screen + 162*3)
lcd_page4   equ (screen + 162*4)
lcd_page5   equ (screen + 162*5)
lcd_page6   equ (screen + 162*6)
lcd_page7   equ (screen + 162*7)

;.array pattern .byte
;$00
;.enda

pattern dta   $00
 
 
